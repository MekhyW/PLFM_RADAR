`timescale 1ns / 1ps

`include "radar_params.vh"

// ============================================================================
// plfm_chirp_controller_v2.v — DAC playback driver for the 3-ladder waveform
// set (chirp-v2 PR-E). Replaces plfm_chirp_controller_enhanced.
// ============================================================================
// chirp-v1 plfm_chirp_controller_enhanced owned an internal 6-state FSM
// (LONG_CHIRP / LONG_LISTEN / GUARD_TIME / SHORT_CHIRP / SHORT_LISTEN / DONE)
// that duplicated the timing the receiver-side mode controller already had.
// chirp-v2 makes the chirp_scheduler (clk_100m, RX side) authoritative for
// inter-chirp timing (LISTEN, GUARD, frame boundaries) and the wave_sel rail.
//
// This module is then a *pure DAC playback driver*:
//
//   IDLE  ──(dst_chirp_valid pulse)──>  CHIRP  ──(N samples played)──>  IDLE
//
// where N depends on dst_wave_sel:
//
//      RP_WAVE_SHORT   →  120 samples @ 120 MHz =  1 µs
//      RP_WAVE_MEDIUM  →  600 samples @ 120 MHz =  5 µs
//      RP_WAVE_LONG    → 3600 samples @ 120 MHz = 30 µs
//
// Sample data sources (.mem files generated by tb/cosim/gen_chirp_mem.py
// PR-B; 8-bit unsigned offset-binary, idle code = 8'd128):
//
//      tx_short_lut.mem   (120 entries)  — inline LUTRAM
//      tx_medium_lut.mem  (600 entries)  — inline LUTRAM
//      tx_long_lut.mem    (3600 entries) — inferred BRAM (sync read)
//
// Inputs from the scheduler (clk_100m → clk_120m crossing handled in the
// parent radar_transmitter via cdc_async_fifo for {wave_sel} + toggle CDC
// for frame_pulse):
//
//      dst_chirp_valid   1-cycle pulse on clk_120m, "begin a new chirp"
//      dst_wave_sel[1:0] valid alongside dst_chirp_valid; one of RP_WAVE_*
//      frame_pulse_120m  1-cycle pulse on clk_120m, "frame boundary"
//                        (clears chirp_counter so frame N+1 starts at 0)
//
// Mixer / RF-switch / ADAR T-R:
//   tx_mixer_en, rf_switch_ctrl, adar_tr_*  asserted during ST_CHIRP only.
//   rx_mixer_en asserted whenever mixers_enable=1 and we're NOT in ST_CHIRP
//   (i.e. the radar is listening). v1 gated rx_mixer_en strictly to
//   {LONG,SHORT}_LISTEN; v2 also covers the scheduler's GUARD window. The
//   GUARD window is RF-quiet by construction so the radar sees nothing
//   useful and the change is benign — revisit in PR-H if a finer gate is
//   needed.
//
// Beam steering:
//   elevation_counter / azimuth_counter remain on clk_100m and are bumped
//   by the STM32 toggle inputs (independent of the chirp FSM), unchanged
//   from v1.
//
// chirp_counter:
//   Increments by 1 each time we leave ST_CHIRP (i.e. one chirp finished).
//   Cleared on frame_pulse_120m so it tracks chirp index within the current
//   frame, matching the chirp_scheduler's chirp_counter.
//
// new_chirp_frame:
//   Mirrors frame_pulse_120m. Same 1-cycle pulse semantics as the v1 output.
// ============================================================================
module plfm_chirp_controller_v2 (
    input  wire        clk_120m,
    input  wire        clk_100m,
    input  wire        reset_n,        // 120m-domain reset
    input  wire        reset_100m_n,   // 100m-domain reset (elev/az counters)

    input  wire        mixers_enable,  // CDC-synced to clk_120m

    // From scheduler via cdc_async_fifo + toggle CDC (clk_120m domain)
    input  wire        dst_chirp_valid,
    input  wire [1:0]  dst_wave_sel,
    input  wire        frame_pulse_120m,

    // STM32 beam-step toggle inputs (clk_100m, edge-detected upstream)
    input  wire        new_elevation,
    input  wire        new_azimuth,

    // DAC outputs
    output reg  [7:0]  chirp_data,
    output reg         chirp_valid,
    output wire        new_chirp_frame,
    output reg         chirp_done,
    output reg         rf_switch_ctrl,
    output wire        rx_mixer_en,
    output wire        tx_mixer_en,

    // ADAR control (loads tied off; T/R pulsed during chirp)
    output wire        adar_tx_load_1,
    output wire        adar_rx_load_1,
    output wire        adar_tx_load_2,
    output wire        adar_rx_load_2,
    output wire        adar_tx_load_3,
    output wire        adar_rx_load_3,
    output wire        adar_tx_load_4,
    output wire        adar_rx_load_4,
    output reg         adar_tr_1,
    output reg         adar_tr_2,
    output reg         adar_tr_3,
    output reg         adar_tr_4,

    // Status counters
    output reg  [5:0]  chirp_counter,
    output reg  [5:0]  elevation_counter,
    output reg  [5:0]  azimuth_counter
);

// ----------------------------------------------------------------------------
// Waveform sample counts (must match tb/cosim/gen_chirp_mem.py)
// ----------------------------------------------------------------------------
localparam SHORT_SAMPLES  = 12'd120;
localparam MEDIUM_SAMPLES = 12'd600;
localparam LONG_SAMPLES   = 12'd3600;

// Beam ranges
parameter ELEVATION_MAX = 31;
parameter AZIMUTH_MAX   = 50;

// ----------------------------------------------------------------------------
// FSM
// ----------------------------------------------------------------------------
localparam ST_IDLE  = 1'b0;
localparam ST_CHIRP = 1'b1;

reg        state;
reg [1:0]  active_wave_sel;
reg [11:0] sample_counter;
reg [11:0] active_max_samples;

// ----------------------------------------------------------------------------
// LUTs — long is BRAM (sync read), short/medium are inline LUTRAM (combinational)
// ----------------------------------------------------------------------------
(* ram_style = "block" *) reg [7:0] tx_long_lut   [0:LONG_SAMPLES-1];
                          reg [7:0] tx_medium_lut [0:MEDIUM_SAMPLES-1];
                          reg [7:0] tx_short_lut  [0:SHORT_SAMPLES-1];

reg [7:0] long_rd_data;
always @(posedge clk_120m) begin
    long_rd_data <= tx_long_lut[sample_counter];
end

initial begin
    $readmemh("tx_long_lut.mem",   tx_long_lut);
    $readmemh("tx_medium_lut.mem", tx_medium_lut);
    $readmemh("tx_short_lut.mem",  tx_short_lut);
end

// ----------------------------------------------------------------------------
// Combinational helpers
// ----------------------------------------------------------------------------
function [11:0] wave_to_samples;
    input [1:0] w;
    begin
        case (w)
            `RP_WAVE_SHORT:  wave_to_samples = SHORT_SAMPLES;
            `RP_WAVE_MEDIUM: wave_to_samples = MEDIUM_SAMPLES;
            `RP_WAVE_LONG:   wave_to_samples = LONG_SAMPLES;
            default:         wave_to_samples = SHORT_SAMPLES;  // RESERVED → safe fallback
        endcase
    end
endfunction

reg [7:0] active_sample_data;
always @(*) begin
    case (active_wave_sel)
        `RP_WAVE_SHORT:  active_sample_data = tx_short_lut [sample_counter[6:0]];
        `RP_WAVE_MEDIUM: active_sample_data = tx_medium_lut[sample_counter[9:0]];
        `RP_WAVE_LONG:   active_sample_data = long_rd_data;
        default:         active_sample_data = 8'd128;
    endcase
end

// ----------------------------------------------------------------------------
// Static outputs
// ----------------------------------------------------------------------------
assign new_chirp_frame = frame_pulse_120m;
assign tx_mixer_en     = mixers_enable && (state == ST_CHIRP);
assign rx_mixer_en     = mixers_enable && (state != ST_CHIRP);

// ADTR1000 load pins are unused on this board — tie low.
assign adar_tx_load_1 = 1'b0;
assign adar_rx_load_1 = 1'b0;
assign adar_tx_load_2 = 1'b0;
assign adar_rx_load_2 = 1'b0;
assign adar_tx_load_3 = 1'b0;
assign adar_rx_load_3 = 1'b0;
assign adar_tx_load_4 = 1'b0;
assign adar_rx_load_4 = 1'b0;

// ----------------------------------------------------------------------------
// Main FSM (clk_120m)
// ----------------------------------------------------------------------------
always @(posedge clk_120m or negedge reset_n) begin
    if (!reset_n) begin
        state              <= ST_IDLE;
        active_wave_sel    <= `RP_WAVE_SHORT;
        sample_counter     <= 12'd0;
        active_max_samples <= 12'd0;
        chirp_data         <= 8'd128;
        chirp_valid        <= 1'b0;
        chirp_done         <= 1'b0;
        rf_switch_ctrl     <= 1'b0;
        adar_tr_1          <= 1'b0;
        adar_tr_2          <= 1'b0;
        adar_tr_3          <= 1'b0;
        adar_tr_4          <= 1'b0;
        chirp_counter      <= 6'd0;
    end else if (mixers_enable) begin
        chirp_done <= 1'b0;  // default: deassert pulse

        case (state)
            ST_IDLE: begin
                chirp_data     <= 8'd128;
                chirp_valid    <= 1'b0;
                rf_switch_ctrl <= 1'b0;
                {adar_tr_1, adar_tr_2, adar_tr_3, adar_tr_4} <= 4'b0000;

                if (dst_chirp_valid) begin
                    state              <= ST_CHIRP;
                    active_wave_sel    <= dst_wave_sel;
                    active_max_samples <= wave_to_samples(dst_wave_sel);
                    sample_counter     <= 12'd0;
                end
            end

            ST_CHIRP: begin
                rf_switch_ctrl <= 1'b1;
                {adar_tr_1, adar_tr_2, adar_tr_3, adar_tr_4} <= 4'b1111;
                chirp_data     <= active_sample_data;
                chirp_valid    <= 1'b1;

                if (sample_counter == active_max_samples - 12'd1) begin
                    // End of this chirp — return to IDLE, pulse chirp_done,
                    // and bump chirp_counter (frame_pulse will clear it below).
                    state          <= ST_IDLE;
                    sample_counter <= 12'd0;
                    chirp_data     <= 8'd128;
                    chirp_valid    <= 1'b0;
                    chirp_done     <= 1'b1;
                    rf_switch_ctrl <= 1'b0;
                    {adar_tr_1, adar_tr_2, adar_tr_3, adar_tr_4} <= 4'b0000;
                    chirp_counter  <= chirp_counter + 6'd1;
                end else begin
                    sample_counter <= sample_counter + 12'd1;
                end
            end

            default: state <= ST_IDLE;
        endcase

        // frame_pulse always wins — restart chirp index for the next frame.
        if (frame_pulse_120m) begin
            chirp_counter <= 6'd0;
        end
    end else begin
        // mixers_enable LOW: hold quiescent (and reset the FSM so a glitch on
        // dst_chirp_valid during disable can't sneak us into ST_CHIRP).
        state          <= ST_IDLE;
        chirp_data     <= 8'd128;
        chirp_valid    <= 1'b0;
        chirp_done     <= 1'b0;
        rf_switch_ctrl <= 1'b0;
        {adar_tr_1, adar_tr_2, adar_tr_3, adar_tr_4} <= 4'b0000;
        sample_counter <= 12'd0;
    end
end

// ----------------------------------------------------------------------------
// Beam steering counters (clk_100m, independent of chirp FSM) — unchanged from v1.
// ----------------------------------------------------------------------------
always @(posedge clk_100m or negedge reset_100m_n) begin
    if (!reset_100m_n) begin
        elevation_counter <= 6'd1;
    end else if (new_elevation) begin
        if (elevation_counter == ELEVATION_MAX)
            elevation_counter <= 6'd1;
        else
            elevation_counter <= elevation_counter + 6'd1;
    end
end

always @(posedge clk_100m or negedge reset_100m_n) begin
    if (!reset_100m_n) begin
        azimuth_counter <= 6'd1;
    end else if (new_azimuth) begin
        if (azimuth_counter == AZIMUTH_MAX)
            azimuth_counter <= 6'd1;
        else
            azimuth_counter <= azimuth_counter + 6'd1;
    end
end

endmodule
